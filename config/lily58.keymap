// Copyright 2021 Manna Harbour
// https://github.com/manna-harbour/miryoku

#include "../miryoku/custom_config.h"

#if defined(MIRYOKU_MULTI_LAYOUT)
#include "../miryoku/multi_layout/layer_list.h"
#endif

#include "../miryoku/mapping/58/lily58.h"
#include "../miryoku/miryoku.dtsi"
